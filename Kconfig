## Kconfig
```kconfig
# SPDX-License-Identifier: MIT
# Kconfig for ZMK Multi-Level Input Processor Acceleration

config ZMK_INPUT_PROCESSOR_ACCELERATION
    bool "Enable input processor acceleration"
    default n
    depends on ZMK_POINTING
    depends on INPUT
    help
        Enables multi-level velocity-based acceleration for relative pointer input events.
        Choose from Simple or Standard configuration levels.

config INPUT_PROCESSOR_ACCELERATION_INIT_PRIORITY
    int "Input processor acceleration initialization priority"
    default 90
    depends on ZMK_INPUT_PROCESSOR_ACCELERATION

# =============================================================================
# CONFIGURATION LEVEL SELECTION
# =============================================================================

choice INPUT_PROCESSOR_ACCEL_LEVEL
    prompt "Acceleration Configuration Level"
    depends on ZMK_INPUT_PROCESSOR_ACCELERATION
    default INPUT_PROCESSOR_ACCEL_LEVEL_SIMPLE
    help
      Choose the complexity level for pointing device acceleration configuration:
      - Simple: 3 basic settings with presets (recommended for most users)
      - Standard: 7 settings with speed-based acceleration, Y-axis boost, and advanced curves

config INPUT_PROCESSOR_ACCEL_LEVEL_SIMPLE
    bool "Simple (3 settings + presets)"
    help
      Simple configuration with basic sensitivity, maximum acceleration,
      and curve type. Includes preset configurations for common use cases.

config INPUT_PROCESSOR_ACCEL_LEVEL_STANDARD
    bool "Standard (7 settings)"
    help
      Standard configuration with speed-based acceleration, Y-axis boost,
      configurable speed thresholds, and advanced curve customization.

endchoice

config INPUT_PROCESSOR_ACCEL_LEVEL
    int
    default 1 if INPUT_PROCESSOR_ACCEL_LEVEL_SIMPLE
    default 2 if INPUT_PROCESSOR_ACCEL_LEVEL_STANDARD

# =============================================================================
# LEVEL 1: SIMPLE CONFIGURATION
# =============================================================================

if INPUT_PROCESSOR_ACCEL_LEVEL_SIMPLE

choice INPUT_PROCESSOR_ACCEL_PRESET
    prompt "Acceleration Preset"
    default INPUT_PROCESSOR_ACCEL_PRESET_CUSTOM
    help
      Choose a preset configuration based on usage and device type.

config INPUT_PROCESSOR_ACCEL_PRESET_CUSTOM
    bool "Custom (configure manually)"

# Office presets
config INPUT_PROCESSOR_ACCEL_PRESET_OFFICE_OPTICAL
    bool "Office - Optical Mouse (800 DPI)"
    help
      Conservative acceleration for office work with standard optical mouse.
      DPI: 800, Sensitivity: 1.0x, Max acceleration: 2.2x

config INPUT_PROCESSOR_ACCEL_PRESET_OFFICE_LASER
    bool "Office - Laser Mouse (1600 DPI)"
    help
      Conservative acceleration for office work with laser mouse.
      DPI: 1600, Sensitivity: 0.8x, Max acceleration: 2.2x

config INPUT_PROCESSOR_ACCEL_PRESET_OFFICE_TRACKBALL
    bool "Office - Trackball (400 DPI)"
    help
      Conservative acceleration for office work with trackball.
      DPI: 400, Sensitivity: 1.5x, Max acceleration: 2.0x

config INPUT_PROCESSOR_ACCEL_PRESET_OFFICE_TRACKPAD
    bool "Office - Trackpad/Touchpad (1000 DPI)"
    help
      Conservative acceleration for office work with trackpad/touchpad.
      DPI: 1000, Sensitivity: 1.2x, Max acceleration: 1.8x

# Gaming presets
config INPUT_PROCESSOR_ACCEL_PRESET_GAMING_OPTICAL
    bool "Gaming - Optical Mouse (1200 DPI)"
    help
      Balanced acceleration for gaming with optical mouse.
      DPI: 1200, Sensitivity: 1.0x, Max acceleration: 2.5x

config INPUT_PROCESSOR_ACCEL_PRESET_GAMING_LASER
    bool "Gaming - Laser Mouse (3200 DPI)"
    help
      Balanced acceleration for gaming with high-DPI laser mouse.
      DPI: 3200, Sensitivity: 0.6x, Max acceleration: 2.5x

config INPUT_PROCESSOR_ACCEL_PRESET_GAMING_TRACKBALL
    bool "Gaming - Trackball (800 DPI)"
    help
      Balanced acceleration for gaming with trackball.
      DPI: 800, Sensitivity: 1.2x, Max acceleration: 2.3x

config INPUT_PROCESSOR_ACCEL_PRESET_GAMING_TRACKPAD
    bool "Gaming - Trackpad/Touchpad (1200 DPI)"
    help
      Balanced acceleration for gaming with trackpad/touchpad.
      DPI: 1200, Sensitivity: 1.1x, Max acceleration: 2.2x

# High sensitivity presets
config INPUT_PROCESSOR_ACCEL_PRESET_HIGH_SENS_OPTICAL
    bool "High Sensitivity - Optical Mouse (1600 DPI)"
    help
      High sensitivity for fast movements with optical mouse.
      DPI: 1600, Sensitivity: 1.1x, Max acceleration: 2.8x

config INPUT_PROCESSOR_ACCEL_PRESET_HIGH_SENS_LASER
    bool "High Sensitivity - Laser Mouse (6400 DPI)"
    help
      High sensitivity for fast movements with high-DPI laser mouse.
      DPI: 6400, Sensitivity: 0.5x, Max acceleration: 2.8x

config INPUT_PROCESSOR_ACCEL_PRESET_HIGH_SENS_TRACKBALL
    bool "High Sensitivity - Trackball (800 DPI)"
    help
      High sensitivity for fast movements with trackball.
      DPI: 800, Sensitivity: 1.4x, Max acceleration: 2.6x

config INPUT_PROCESSOR_ACCEL_PRESET_HIGH_SENS_TRACKPAD
    bool "High Sensitivity - Trackpad/Touchpad (1200 DPI)"
    help
      High sensitivity for fast movements with trackpad/touchpad.
      DPI: 1200, Sensitivity: 1.3x, Max acceleration: 2.4x

endchoice

config INPUT_PROCESSOR_ACCEL_SENSITIVITY
    int "Base sensitivity (scaled by 1000)"
    default 1000
    depends on INPUT_PROCESSOR_ACCEL_PRESET_CUSTOM
    range 200 2000
    help
      Base sensitivity multiplier. 400 = 0.4x (precise control), 1000 = 1.0x, 1200 = 1.2x.
      Lower values provide more precise control, higher values increase sensitivity.

config INPUT_PROCESSOR_ACCEL_MAX_FACTOR
    int "Maximum acceleration factor (scaled by 1000)"
    default 2000
    depends on INPUT_PROCESSOR_ACCEL_PRESET_CUSTOM
    range 1000 3000
    help
      Maximum acceleration factor at high speeds. 2000 = 2.0x (moderate acceleration).

config INPUT_PROCESSOR_ACCEL_CURVE_TYPE
    int "Acceleration curve type"
    default 1
    depends on INPUT_PROCESSOR_ACCEL_PRESET_CUSTOM
    range 0 2
    help
      Acceleration curve type:
      0 = Linear (gradual acceleration)
      1 = Mild (smooth acceleration) [DEFAULT]
      2 = Strong (aggressive acceleration)

config INPUT_PROCESSOR_ACCEL_Y_BOOST
    int "Y-axis sensitivity boost (scaled by 1000)"
    default 1000
    depends on INPUT_PROCESSOR_ACCEL_PRESET_CUSTOM
    range 500 3000
    help
      Y-axis sensitivity multiplier. 1000 = same as X-axis, 1200 = 1.2x Y-axis.
      Useful for widescreen displays where vertical movement needs boosting.

config INPUT_PROCESSOR_ACCEL_SENSOR_DPI
    int "Pointing device sensor DPI/CPI setting"
    default 800
    depends on INPUT_PROCESSOR_ACCEL_PRESET_CUSTOM
    range 400 8000
    help
      DPI/CPI setting of the pointing device sensor. Used for sensitivity scaling.
      Standard values: 400, 800, 1200, 1600, 3200 DPI.

endif # INPUT_PROCESSOR_ACCEL_LEVEL_SIMPLE

# =============================================================================
# LEVEL 2: STANDARD CONFIGURATION
# =============================================================================

if INPUT_PROCESSOR_ACCEL_LEVEL_STANDARD

choice INPUT_PROCESSOR_ACCEL_PRESET
    prompt "Acceleration Preset"
    default INPUT_PROCESSOR_ACCEL_PRESET_CUSTOM
    help
      Choose a preset configuration based on usage and device type.

config INPUT_PROCESSOR_ACCEL_PRESET_CUSTOM
    bool "Custom (configure manually)"

# Office presets
config INPUT_PROCESSOR_ACCEL_PRESET_OFFICE_OPTICAL
    bool "Office - Optical Mouse (800 DPI)"
    help
      Conservative acceleration for office work with standard optical mouse.

config INPUT_PROCESSOR_ACCEL_PRESET_OFFICE_LASER
    bool "Office - Laser Mouse (1600 DPI)"
    help
      Conservative acceleration for office work with laser mouse.

config INPUT_PROCESSOR_ACCEL_PRESET_OFFICE_TRACKBALL
    bool "Office - Trackball (400 DPI)"
    help
      Conservative acceleration for office work with trackball.

config INPUT_PROCESSOR_ACCEL_PRESET_OFFICE_TRACKPAD
    bool "Office - Trackpad/Touchpad (1000 DPI)"
    help
      Conservative acceleration for office work with trackpad/touchpad.

# Gaming presets
config INPUT_PROCESSOR_ACCEL_PRESET_GAMING_OPTICAL
    bool "Gaming - Optical Mouse (1200 DPI)"
    help
      Balanced acceleration for gaming with optical mouse.

config INPUT_PROCESSOR_ACCEL_PRESET_GAMING_LASER
    bool "Gaming - Laser Mouse (3200 DPI)"
    help
      Balanced acceleration for gaming with high-DPI laser mouse.

config INPUT_PROCESSOR_ACCEL_PRESET_GAMING_TRACKBALL
    bool "Gaming - Trackball (800 DPI)"
    help
      Balanced acceleration for gaming with trackball.

config INPUT_PROCESSOR_ACCEL_PRESET_GAMING_TRACKPAD
    bool "Gaming - Trackpad/Touchpad (1200 DPI)"
    help
      Balanced acceleration for gaming with trackpad/touchpad.

# High sensitivity presets
config INPUT_PROCESSOR_ACCEL_PRESET_HIGH_SENS_OPTICAL
    bool "High Sensitivity - Optical Mouse (1600 DPI)"
    help
      High sensitivity for fast movements with optical mouse.

config INPUT_PROCESSOR_ACCEL_PRESET_HIGH_SENS_LASER
    bool "High Sensitivity - Laser Mouse (6400 DPI)"
    help
      High sensitivity for fast movements with high-DPI laser mouse.

config INPUT_PROCESSOR_ACCEL_PRESET_HIGH_SENS_TRACKBALL
    bool "High Sensitivity - Trackball (800 DPI)"
    help
      High sensitivity for fast movements with trackball.

config INPUT_PROCESSOR_ACCEL_PRESET_HIGH_SENS_TRACKPAD
    bool "High Sensitivity - Trackpad/Touchpad (1200 DPI)"
    help
      High sensitivity for fast movements with trackpad/touchpad.

endchoice

config INPUT_PROCESSOR_ACCEL_SENSITIVITY
    int "Base sensitivity (scaled by 1000)"
    default 1000
    depends on INPUT_PROCESSOR_ACCEL_PRESET_CUSTOM
    range 200 2000
    help
      Base sensitivity multiplier. 400 = 0.4x (precise control), 1000 = 1.0x, 1200 = 1.2x.

config INPUT_PROCESSOR_ACCEL_MAX_FACTOR
    int "Maximum acceleration factor (scaled by 1000)"
    default 2000
    depends on INPUT_PROCESSOR_ACCEL_PRESET_CUSTOM
    range 1000 3000
    help
      Maximum acceleration factor at high speeds. 2000 = 2.0x (moderate acceleration).

config INPUT_PROCESSOR_ACCEL_CURVE_TYPE
    int "Acceleration curve type"
    default 1
    depends on INPUT_PROCESSOR_ACCEL_PRESET_CUSTOM
    range 0 2
    help
      Acceleration curve type:
      0 = Linear, 1 = Mild [DEFAULT], 2 = Strong

config INPUT_PROCESSOR_ACCEL_Y_BOOST
    int "Y-axis sensitivity boost (scaled by 1000)"
    default 1000
    depends on INPUT_PROCESSOR_ACCEL_PRESET_CUSTOM
    range 800 2000
    help
      Y-axis sensitivity multiplier. 1000 = same as X-axis, 1200 = 1.2x Y-axis.
      Useful for widescreen displays where vertical movement needs boosting.

config INPUT_PROCESSOR_ACCEL_SPEED_THRESHOLD
    int "Speed threshold for acceleration start"
    default 600
    depends on INPUT_PROCESSOR_ACCEL_PRESET_CUSTOM
    range 100 2000
    help
      Speed threshold (counts per second) below which no acceleration is applied.

config INPUT_PROCESSOR_ACCEL_SPEED_MAX
    int "Speed for maximum acceleration"
    default 3500
    depends on INPUT_PROCESSOR_ACCEL_PRESET_CUSTOM
    range 1000 8000
    help
      Speed (counts per second) at which maximum acceleration factor is reached.

config INPUT_PROCESSOR_ACCEL_MIN_FACTOR
    int "Minimum acceleration factor (scaled by 1000)"
    default 900
    depends on INPUT_PROCESSOR_ACCEL_PRESET_CUSTOM
    range 200 1500
    help
      Minimum acceleration factor. Values <1000 slow down movements at very low speeds.
      1000 = 1.0x (no change), 800 = 0.8x (slower), 1200 = 1.2x (faster).

config INPUT_PROCESSOR_ACCEL_EXPONENT
    int "Acceleration curve type"
    default 2
    depends on INPUT_PROCESSOR_ACCEL_PRESET_CUSTOM
    range 1 5
    help
      Advanced acceleration curve type:
      1 = Linear curve (f(t) = t)
      2 = Mild exponential curve (f(t) = e^(2t) - 1) [DEFAULT]
      3 = Moderate exponential curve (f(t) = e^(3t) - 1)
      4 = Strong exponential curve (f(t) = e^(4t) - 1)
      5 = Aggressive exponential curve (f(t) = e^(5t) - 1)

config INPUT_PROCESSOR_ACCEL_SENSOR_DPI
    int "Pointing device sensor DPI/CPI setting"
    default 800
    depends on INPUT_PROCESSOR_ACCEL_PRESET_CUSTOM
    range 400 8000
    help
      DPI/CPI setting of the pointing device sensor. Used for sensitivity scaling.
      Standard values: 400, 800, 1200, 1600, 3200 DPI.

# Remainder tracking removed for safety and simplicity
# The precision loss (1/1000) is negligible for practical mouse usage

endif # INPUT_PROCESSOR_ACCEL_LEVEL_STANDARD
```
