## dts/bindings/zmk,input-processor-acceleration.yaml
```yaml
# SPDX-License-Identifier: MIT
description: ZMK Multi-Level Pointer Acceleration Input Processor

compatible: "zmk,input-processor-acceleration"

properties:
  input-type:
    type: int
    required: true
    description: Input event type to accelerate (e.g. INPUT_EV_REL for relative events)

  codes:
    type: array
    required: true
    description: Array of event code values to accelerate (e.g. REL_X, REL_Y)

  track-remainders:
    type: boolean
    description: |
      Accumulate and apply fractional movement remainders for higher precision.
      This is a boolean property - include it to enable, omit it to disable.
      Usage: track-remainders; (not track-remainders = <1>;)

  # =============================================================================
  # LEVEL 1: SIMPLE PROPERTIES (Available when CONFIG_INPUT_PROCESSOR_ACCEL_LEVEL=1)
  # =============================================================================

  sensitivity:
    type: int
    default: 1200
    description: |
      [LEVEL 1] Base sensitivity multiplier (scaled by 1000).
      1000 = 1.0x, 1200 = 1.2x, 1500 = 1.5x
      Simple way to adjust overall mouse sensitivity.

  max-factor:
    type: int
    default: 2500
    description: |
      [LEVEL 1] Maximum acceleration factor (scaled by 1000).
      2500 = 2.5x maximum acceleration at high speeds.

  curve-type:
    type: int
    default: 1
    description: |
      [LEVEL 1] Acceleration curve type:
      0 = Linear (gradual acceleration)
      1 = Mild (smooth acceleration) [DEFAULT]
      2 = Strong (aggressive acceleration)

  # =============================================================================
  # LEVEL 2: STANDARD PROPERTIES (Available when CONFIG_INPUT_PROCESSOR_ACCEL_LEVEL=2)
  # =============================================================================

  y-boost:
    type: int
    default: 1200
    description: |
      [LEVEL 2] Y-axis sensitivity boost (scaled by 1000).
      1000 = same as X-axis, 1200 = 1.2x Y-axis sensitivity.
      Useful for widescreen displays.

  speed-threshold:
    type: int
    default: 500
    description: |
      [LEVEL 2] Speed threshold for acceleration start (counts per second).
      Below this speed, no acceleration is applied.

  speed-max:
    type: int
    default: 3500
    description: |
      [LEVEL 2] Speed at which maximum acceleration is reached (counts per second).
      Movements faster than this use the maximum acceleration factor.

  # =============================================================================
  # LEVEL 3: ADVANCED PROPERTIES (Available when CONFIG_INPUT_PROCESSOR_ACCEL_LEVEL=3)
  # =============================================================================

  min-factor:
    type: int
    default: 1000
    description: |
      [LEVEL 3] Minimum acceleration factor (scaled by 1000).
      Values <1000 slow down movements at very low speeds.

  acceleration-exponent:
    type: int
    default: 2
    description: |
      [LEVEL 3] Advanced acceleration curve type:
      1 = Linear curve (f(t) = t)
      2 = Mild exponential curve (f(t) = e^(2t) - 1) [DEFAULT]
      3 = Moderate exponential curve (f(t) = e^(3t) - 1)
      4 = Strong exponential curve (f(t) = e^(4t) - 1)
      5 = Aggressive exponential curve (f(t) = e^(5t) - 1)
      10 = Quadratic polynomial (f(t) = t^2)
      11 = Cubic polynomial (f(t) = t^3)
      12 = Quartic polynomial (f(t) = t^4)
      13 = Quintic polynomial (f(t) = t^5)

  sensor-dpi:
    type: int
    default: 800
    description: |
      [ALL LEVELS] Mouse sensor DPI/CPI setting.
      Used for automatic sensitivity scaling. Common values: 400, 800, 1200, 1600, 3200.
      Higher DPI sensors will have reduced sensitivity to maintain consistent feel.
```
